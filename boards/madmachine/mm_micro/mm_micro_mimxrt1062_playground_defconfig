## boards/madmachine/mm_micro/mm_micro_mimxrt1062_playground_defconfig
```kconfig
#
# Copyright (c) 2021, MADMACHINE LIMITED
#
# SPDX-License-Identifier: Apache-2.0
#

CONFIG_NXP_IMXRT_BOOT_HEADER=n
CONFIG_XIP=n
CONFIG_LINKER_LAST_SECTION_ID=n

#CONFIG_HEAP_MEM_POOL_SIZE=2843200
CONFIG_THREAD_MONITOR=y
CONFIG_DEBUG_THREAD_INFO=y

CONFIG_FLASH=y
CONFIG_FLASH_MAP=y
CONFIG_STREAM_FLASH=y
CONFIG_STREAM_FLASH_ERASE=y

CONFIG_FILE_SYSTEM=y
CONFIG_FLASH_PAGE_LAYOUT=y
CONFIG_FILE_SYSTEM_LITTLEFS=y
```

## drivers/kscan/Kconfig.gt9157
```kconfig
# Copyright (c) 2020 Frank
# SPDX-License-Identifier: Apache-2.0

menuconfig KSCAN_GT9157
	bool "GT9157 capacitive touch panel driver"
	depends on I2C && HAS_DTS_I2C
	help
	  Enable driver for the FT5336 capacitive touch panel controller.

config KSCAN_GT9157_PERIOD
	int "Sample period (ms)"
	default 10
	depends on KSCAN_GT9157
```

## dts/bindings/kscan/coodix,gt9157.yaml
```yaml
# Copyright (c) 2020 Frank
# SPDX-License-Identifier: Apache-2.0

description: GT9157 capacitive touch panel

compatible: "coodix,gt9157"

include: [kscan.yaml, i2c-device.yaml]

properties:
    int-gpios:
      type: phandle-array
      required: false
    reset-gpios:
      type: phandle-array
      required: false
```
